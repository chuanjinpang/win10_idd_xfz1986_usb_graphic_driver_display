## device_porting/esp-idf5.3_udisp_s3_st7789_example/components/espressif__esp_new_jpeg/test_app/sdkconfig.defaults
```kconfig
#
# ESP System Settings
#
CONFIG_ESP_TASK_WDT_EN=n

#
# FreeRTOS
#
CONFIG_FREERTOS_HZ=1000
CONFIG_FREERTOS_ENABLE_BACKWARD_COMPATIBILITY=y

#
# SPI RAM config
#
CONFIG_SPIRAM=y
CONFIG_SPIRAM_BOOT_INIT=y

#
# FAT Filesystem support
#
CONFIG_FATFS_CODEPAGE_936=y
CONFIG_FATFS_LFN_HEAP=y
CONFIG_FATFS_MAX_LFN=255
CONFIG_FATFS_FS_LOCK=5
```

## device_porting/esp-idf5.3_udisp_s3_st7789_example/components/espressif__esp_new_jpeg/test_app/sdkconfig.defaults.esp32s3
```kconfig
#
# ESP32S3-Specific
#
CONFIG_ESP32S3_DEFAULT_CPU_FREQ_240=y
CONFIG_ESP32S3_DEFAULT_CPU_FREQ_MHZ=240
CONFIG_ESP32S3_SPIRAM_SUPPORT=y

#
# SPI RAM config
#
CONFIG_ESP32S3_SPIRAM_SUPPORT=y
CONFIG_SPIRAM_MODE_OCT=y
CONFIG_SPIRAM_TYPE_AUTO=y
```

## device_porting/esp-idf5.3_udisp_s3_st7789_example/components/leeebo__tinyusb_src/Kconfig
```kconfig
menu "TinyUSB soucre"

    config TINYUSB_SOURCE_CODE_ONLY
        bool "Using tinyusb source code only"
        default n
        help
            "Select if you just use the source code, not build as a library"
    config USING_SYNOPSYS_DWC2_DRIVER
        bool "Using synopsys dwc2 driver, otherwise using esp32sx dcd driver"
        default y
        help
            "For esp32sx, user can choose esp32sx dcd driver or common synopsys dwc2 driver"

endmenu
```
